## package/mtk/applications/hostapd-2.10/Config.in
```kconfig
# wpa_supplicant config
config WPA_RFKILL_SUPPORT
	bool "Add rfkill support"
	depends on PACKAGE_wpa-supplicant-2.10 || \
		   PACKAGE_wpad-2.10
	default n

config WPA_MSG_MIN_PRIORITY
	int "Minimum debug message priority"
	depends on PACKAGE_wpa-supplicant-2.10 || \
		   PACKAGE_wpad-2.10
	default 3
	help
	  Useful values are:
	    0 = all messages
		1 = raw message dumps
		2 = most debugging messages
		3 = info messages
		4 = warnings
		5 = errors

config DRIVER_WEXT_SUPPORT
	bool
	select KERNEL_WIRELESS_EXT
	default n

config DRIVER_11N_SUPPORT
	bool
	default n

config DRIVER_11AC_SUPPORT
	bool
	default n

config DRIVER_11AX_SUPPORT
	bool
	default n

config WPA_ENABLE_WEP
	bool "Enable support for unsecure and obsolete WEP"
	help
	  Wired equivalent privacy (WEP) is an obsolete cryptographic data
	  confidentiality algorithm that is not considered secure. It should not be used
	  for anything anymore. The functionality needed to use WEP is available in the
	  current hostapd release under this optional build parameter and completely
	  removed in a future release.
```
